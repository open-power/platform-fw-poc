## meta-opbuild/meta-powerhost/conf/machine/hostbuild.conf
```bitbake
MACHINE = "hostbuild"
# Machine name

# Target Architecture
TARGET_ARCH = "powerpc64le"

# Set the cross-compiler to use powerpc64le
TARGET_CC_ARCH += "-m64 -mcpu=power8 -mtune=power9"
TARGET_CXX_ARCH +="-m64 -mcpu=power8 -mtune=power9"

GCCVERSION = "8.2%"

# Define the tunings for PowerPC 64-bit Little Endian
DEFAULTTUNE = "powerpc64le"
TUNE_FEATURES = "powerpc64le"

# Add support for necessary packages
# MACHINE_FEATURES += "efi"

# Ensure package architectures match
PACKAGE_EXTRA_ARCHS = "powerpc64le"

# Select a valid PowerPC64LE-compatible machine as a base
require conf/machine/include/powerpc/arch-powerpc64.inc
```
